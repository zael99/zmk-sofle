## boards/arm/sofle_v2/Kconfig.board
```kconfig
#
# Copyright (c) 2024 The ZMK Contributors
# SPDX-License-Identifier: MIT
#

config BOARD_SOFLE_V2_LEFT
    bool "sofle_v2 left"
    depends on SOC_NRF52840_QIAA

config BOARD_SOFLE_V2_RIGHT
    bool "sofle_v2 right"
    depends on SOC_NRF52840_QIAA
```

## config/west.yml
```yaml
manifest:
  remotes:
    - name: zmkfirmware
      url-base: https://github.com/zmkfirmware
    - name: zael99
      url-base: https://github.com/zael99
  projects:
    - name: zmk
      remote: zmkfirmware
      revision: v0.3
      import: app/west.yml
    - name: zmk-sofle
      remote: zael99
      revision: main
    - name: zmk-persistent-default-layer
      remote: zael99
      revision: main
    - name: zmk-bluetooth-rgb
      remote: zael99
      revision: main
    #- name: zmk-rgb-ext
    #  remote: zael99
    #  revision: main
  self:
    path: boards
```
